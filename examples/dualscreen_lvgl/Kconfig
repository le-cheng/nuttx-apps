## examples/dualscreen_lvgl/Kconfig
```kconfig
#
# For a description of the syntax of this configuration file,
# see the file kconfig-language.txt in the NuttX tools repository.
#

menuconfig EXAMPLES_DUALSCREEN_LVGL
	tristate "Dual Screen LVGL Demo"
	default n
	depends on GRAPHICS_LVGL
	---help---
		Enable dual screen LVGL demo application for virtual large screen mode.
		This demo creates a 1920x720 virtual screen from two 960x720 physical
		screens, using double buffering and DIRECT render mode.

if EXAMPLES_DUALSCREEN_LVGL

config EXAMPLES_DUALSCREEN_LVGL_PRIORITY
	int "dualscreen_lvgl task priority"
	default 100

config EXAMPLES_DUALSCREEN_LVGL_STACKSIZE
	int "dualscreen_lvgl stack size"
	default 65536
	---help---
		Stack size for the dual screen LVGL application.
		Larger stack is needed for virtual large screen buffer allocation.

endif # EXAMPLES_DUALSCREEN_LVGL
```

## examples/lvgldualscreen/Kconfig
```kconfig
#
# For a description of the syntax of this configuration file,
# see the file kconfig-language.txt in the NuttX tools repository.
#

menuconfig EXAMPLES_LVGLDUALSCREEN
	tristate "Dual Screen LVGL Demo"
	default n
	depends on GRAPHICS_LVGL
	---help---
		Enable dual screen LVGL demo application for virtual large screen mode.
		This demo creates a 1920x720 virtual screen from two 960x720 physical
		screens, using double buffering and DIRECT render mode.

if EXAMPLES_LVGLDUALSCREEN

config EXAMPLES_LVGL_DUAL_SCREEN
	bool "Enable dual screen mode"
	default n
	---help---
		Enable dual screen display mode.
		When enabled, the application creates a 1920x720 virtual screen
		from two 960x720 physical screens (/dev/fb0 and /dev/fb1).
		When disabled, the application runs in single screen mode with
		a single 960x720 screen (/dev/fb0).
		
		The code automatically adapts the display logic and UI layout
		based on this configuration option.

config EXAMPLES_LVGLDUALSCREEN_PRIORITY
	int "lvgldualscreen task priority"
	default 100

config EXAMPLES_LVGLDUALSCREEN_STACKSIZE
	int "lvgldualscreen stack size"
	default 65536
	---help---
		Stack size for the dual screen LVGL application.
		Larger stack is needed for virtual large screen buffer allocation.

endif # EXAMPLES_LVGLDUALSCREEN
```
